## conf/bblayers.conf
```bitbake
# POKY_BBLAYERS_CONF_VERSION is increased each time build/conf/bblayers.conf
# changes incompatibly
POKY_BBLAYERS_CONF_VERSION = "2"

BBPATH = "${TOPDIR}"
BBFILES ?= ""

BBLAYERS ?= " \
  /home/nawres/yocto/poky/meta \
  /home/nawres/yocto/poky/meta-poky \
  /home/nawres/yocto/poky/meta-yocto-bsp \
  /home/nawres/yocto/poky/meta-application \
  /home/nawres/yocto/layers/meta-openembedded/meta-oe \
  /home/nawres/yocto/layers/meta-qt5 \
  "
```
